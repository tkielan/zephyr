## drivers/rtc/Kconfig
```kconfig
# Kconfig - RTC configuration options
#
#
# Copyright (c) 2015 Intel Corporation
#
# SPDX-License-Identifier: Apache-2.0
#

#
# Real-Time Clock (RTC) options
#
menuconfig RTC
	bool "Real-Time Clock"
	default n
	help
	  Enable options for Real-Time Clock drivers.

if RTC


config RTC_QMSI
	bool "QMSI RTC Driver"
	depends on QMSI
	default n
	help
	  Build QMSI RTC driver.

config RTC_0_NAME
	string "Driver instance name"
	default "RTC_0"
	depends on RTC
	help
	  RTC driver instance name

config RTC_0_IRQ_PRI
	int "RTC Driver Interrupt priority"
	depends on RTC_QMSI
	help
	  RTC interrupt priority.

config RTC_QMSI_API_REENTRANCY
	bool
	prompt "RTC shim driver API reentrancy"
	default n
	help
	  Enable support for RTC shim driver API reentrancy.

config RTC_STM32
	bool
	prompt "STM32 MCU RTC driver"
	depends on RTC && SOC_FAMILY_STM32
	depends on SOC_SERIES_STM32L4X || SOC_SERIES_STM32F4X || SOC_SERIES_STM32F3X
	default n
	help
	Enable RTC support on the STM32 family of processors.

config RTC_STM32_API_REENTRANCY
	bool
	prompt "STM32 MCU RTC driver API reentrancy"
	depends on RTC_STM32
	default n
	help
	Enable support for RTC driver API reentrancy.

config RTC_STM32_INTERRUPT
	bool
	prompt "STM32 MCU RTC Interrupt Support"
	depends on RTC_STM32
	default n
	help
	Enable interrupt support for the RTC driver of STM32 family.

config RTC_STM32_IRQ_PRIORITY
	int "STM32 MCU RTC driver interrupt priority"
	depends on RTC_STM32_INTERRUPT
	help
	RTC interrupt priority for the RTC driver of STM32 family.

endif # RTC
```
